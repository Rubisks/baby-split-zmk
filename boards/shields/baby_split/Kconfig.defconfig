## boards/shields/baby_split/Kconfig.defconfig
```kconfig
if SHIELD_BABY_SPLIT_LEFT

# Name must be less than 16 characters long!
config ZMK_KEYBOARD_NAME
    default "baby split"

config ZMK_SPLIT_ROLE_CENTRAL
    default y

endif

if SHIELD_BABY_SPLIT_LEFT || SHIELD_BABY_SPLIT_RIGHT

config ZMK_SPLIT
    default y

endif
```

## boards/shields/baby_split/Kconfig.shield
```kconfig
# No whitespace after the comma or in your part name!
config SHIELD_BABY_SPLIT_LEFT
    def_bool $(shields_list_contains,baby_split_left)

# No whitespace after the comma or in your part name!
config SHIELD_BABY_SPLIT_RIGHT
    def_bool $(shields_list_contains,baby_split_right)
```
