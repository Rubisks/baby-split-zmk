#include "baby_split.dtsi"

/* Shift columns to the right half */
&default_transform {
    col-offset = <7>;
};

/* GPIO matrix for RIGHT half */
&default_kscan {

    /* COLUMNS (7) — LEFT HALF ONLY */
    col-gpios = <&gpio0 29 GPIO_ACTIVE_HIGH>,  /* C0 */
                <&gpio0 2 GPIO_ACTIVE_HIGH>,  /* C1 */
                <&gpio1 15 GPIO_ACTIVE_HIGH>,  /* C2 */
                <&gpio1 13 GPIO_ACTIVE_HIGH>,  /* C3 */
                <&gpio1 11 GPIO_ACTIVE_HIGH>,  /* C4 */
                <&gpio0 10 GPIO_ACTIVE_HIGH>,  /* C5 */
                <&gpio0 09 GPIO_ACTIVE_HIGH>;  /* C6 */
};
