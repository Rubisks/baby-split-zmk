#include "my_keyboard.dtsi"

/ {
    chosen {
        zmk,kscan = &kscan0;
        zmk,split-role = "left";
    };

    kscan0: kscan0 {
        compatible = "zmk,kscan-gpio-matrix";

        /* ROWS (5) */
        row-gpios = <&gpio0 20 GPIO_ACTIVE_HIGH>,  /* R0 */
                     <&gpio1 11 GPIO_ACTIVE_HIGH>,  /* R1 */
                     <&gpio0 22 GPIO_ACTIVE_HIGH>,  /* R2 */
                     <&gpio0 24 GPIO_ACTIVE_HIGH>,  /* R3 */
                     <&gpio1 0  GPIO_ACTIVE_HIGH>;  /* R4 */

        /* COLUMNS (7) — LEFT HALF ONLY */
        col-gpios = <&gpio0 31 GPIO_ACTIVE_HIGH>,  /* C0 */
                     <&gpio0 29 GPIO_ACTIVE_HIGH>,  /* C1 */
                     <&gpio0 2  GPIO_ACTIVE_HIGH>,  /* C2 */
                     <&gpio1 15 GPIO_ACTIVE_HIGH>,  /* C3 */
                     <&gpio1 13 GPIO_ACTIVE_HIGH>,  /* C4 */
                     <&gpio1 11 GPIO_ACTIVE_HIGH>,  /* C5 */
                     <&gpio0 9  GPIO_ACTIVE_HIGH>;  /* C6 */

        diode-direction = "col2row";
    };
};
